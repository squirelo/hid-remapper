## firmware-ble-peripheral/boards/arm/holyiot_22046/Kconfig.board
```kconfig
# Holyiot 22046 board configuration
# SPDX-License-Identifier: Apache-2.0

config BOARD_HOLYIOT_22046
	bool "Holyiot 22046 nRF52840"
	depends on SOC_NRF52840_QIAA
```

## firmware-ble-peripheral/boards/arm/holyiot_22046/Kconfig.defconfig
```kconfig
# Holyiot 22046 board configuration
# SPDX-License-Identifier: Apache-2.0

if BOARD_HOLYIOT_22046

config BOARD
	default "holyiot_22046"

config BT_CTLR
	default BT

endif # BOARD_HOLYIOT_22046
```

## firmware-bluetooth/boards/arm/adafruit_itsybitsy_nrf52840/Kconfig.board
```kconfig
# Adafruit ItsyBitsy nRF52840 board configuration

# Copyright (c) 2024
# SPDX-License-Identifier: Apache-2.0

config BOARD_ADAFRUIT_ITSYBITSY_NRF52840
	bool "Adafruit ItsyBitsy nRF52840"
	depends on SOC_NRF52840_QIAA 
```

## firmware-bluetooth/boards/arm/seeed_xiao_nrf52840/Kconfig
```kconfig
# Seeed Studio XIAO nRF52840 board configuration

# Copyright (c) 2020 Tobias Svehagen
# SPDX-License-Identifier: Apache-2.0

config BOARD_ENABLE_DCDC
	bool "DCDC mode"
	select SOC_DCDC_NRF52X
	default y
	depends on BOARD_SEEED_XIAO_NRF52840

menu "Bluetooth"

config BT
    bool "Bluetooth support"
    default y
    select BT_HCI
    select BT_CONN
    select BT_HCI_HOST
    select BT_L2CAP
    select BT_ATT
    select BT_GATT
    select BT_SMP

config BT_GATT
    bool "GATT Services"
    depends on BT
    default y

config BT_GATT_SERVER
    bool "GATT Server"
    depends on BT_GATT
    default y

config BT_HID
    bool "HID over GATT"
    depends on BT_GATT
    default y

config BT_HIDS
    bool "HID Service"
    depends on BT_HID
    default y

config BT_DIS
    bool "Device Information Service"
    depends on BT
    default y

config BT_DIS_MODEL
    string "Model Name"
    depends on BT_DIS
    default "HID Remapper"

config BT_DIS_MANUFACTURER
    string "Manufacturer Name"
    depends on BT_DIS
    default "Your Manufacturer"

endmenu
```
